## firmware/sdkconfig.defaults
```kconfig
CONFIG_IDF_TARGET="esp32s3"
CONFIG_FREERTOS_HZ=1000
CONFIG_ESPTOOLPY_FLASHSIZE_16MB=y
CONFIG_ESPTOOLPY_FLASHSIZE="16MB"
CONFIG_ESP32S3_SPIRAM_SUPPORT=y
CONFIG_SPIRAM_MODE_OCT=y
CONFIG_SPIRAM_USE_MALLOC=y
CONFIG_PARTITION_TABLE_CUSTOM=y
CONFIG_PARTITION_TABLE_CUSTOM_FILENAME="partitions.csv"
CONFIG_LV_FONT_DEFAULT_SIZE=14
CONFIG_LV_USE_LOG=y
CONFIG_LV_COLOR_DEPTH_1=y
CONFIG_LWIP_LOCAL_HOSTNAME="claude-rlcd"
CONFIG_MDNS_MAX_SERVICES=10
CONFIG_HTTPD_WS_SUPPORT=y
```
